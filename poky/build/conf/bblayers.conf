## poky/build/conf/bblayers.conf
```bitbake
# POKY_BBLAYERS_CONF_VERSION is increased each time build/conf/bblayers.conf
# changes incompatibly
POKY_BBLAYERS_CONF_VERSION = "2"

BBPATH = "${TOPDIR}"
BBFILES ?= ""

BBLAYERS ?= " \
  /home/ali/yocto-project/yocto-rasp/poky/meta \
  /home/ali/yocto-project/yocto-rasp/poky/meta-poky \
  /home/ali/yocto-project/yocto-rasp/poky/meta-yocto-bsp \
  "
```
